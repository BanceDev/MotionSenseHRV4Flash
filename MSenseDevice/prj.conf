## prj.conf
```kconfig
#CONFIG_NCS_SAMPLES_DEFAULTS=y

CONFIG_STDOUT_CONSOLE=y

# deprecated:
#CONFIG_CPLUSPLUS=y
#CONFIG_STD_CPP11=y
#CONFIG_NEWLIB_LIBC=y
#CONFIG_LIB_CPLUSPLUS=y


CONFIG_DEBUG_OPTIMIZATIONS=n
#CONFIG_SIZE_OPTIMIZATIONS=y

#Log config
CONFIG_LOG=y
CONFIG_LOG_DEFAULT_LEVEL=3
CONFIG_LOG_MODE_MINIMAL=n
# The thread analyser is a cool logging tool that shows how full stacks are for running threads. It can be used to detect stack overflow errors.
#CONFIG_THREAD_ANALYZER=y
#CONFIG_THREAD_ANALYZER_USE_LOG=y
#CONFIG_THREAD_ANALYZER_AUTO=y


# when working with the MSense Devices, the only debugging tool we have is the SEGGER_RTT and USB debug output. 
# We have a USB, but we have to set it up via CDC UART (CDC is a usb communication protocol) on device tree
CONFIG_USE_SEGGER_RTT=y
CONFIG_RTT_CONSOLE=y

CONFIG_LOG_BACKEND_RTT=y
CONFIG_LOG_BACKEND_UART=y
CONFIG_LOG_PRINTK=y

#CONFIG_RAM_CONSOLE=y
#CONFIG_UART_CONSOLE=n
CONFIG_PRINTK=y





# Our MSense boards don't have a DCDC on them. This is necessary for the boards to function, or else they will brick!
CONFIG_BOARD_ENABLE_DCDC_APP=n
CONFIG_BOARD_ENABLE_DCDC_NET=n

# Clock Control. This KConfig Controls whether we use a Crystal (XTAL) or RC Oscilator.
CONFIG_CLOCK_CONTROL_NRF_K32SRC_RC=n
CONFIG_CLOCK_CONTROL_NRF_K32SRC_RC_CALIBRATION=n

CONFIG_CLOCK_CONTROL_NRF_K32SRC_XTAL=y

CONFIG_SOC_LFXO_CAP_INT_9PF=y
CONFIG_SOC_HFXO_CAP_INTERNAL=y
CONFIG_SOC_HFXO_CAP_INT_VALUE_X2=25


#Gpio Config
CONFIG_GPIO=y
CONFIG_NRFX_GPIOTE=y
# On the 5340 dev kit, pins 0.02 and 0.03 are configured as pins for an NFC antenna. Since we are using those pins for ppg,
# we need to use this KConfig to make them behave like normal. Apparently setting it in device tree is not enough, we have to use this KConfig
CONFIG_NFCT_PINS_AS_GPIOS=y

# SPI Config
CONFIG_SPI=y
#CONFIG_NRFX_QSPI=y

#I2C config
CONFIG_I2C=y
CONFIG_SENSOR=y



# CMSIS config
CONFIG_CMSIS_DSP=y
CONFIG_CMSIS_DSP_BASICMATH=y
CONFIG_CMSIS_DSP_COMPLEXMATH=n
CONFIG_CMSIS_DSP_CONTROLLER=n
CONFIG_CMSIS_DSP_DISTANCE=n
CONFIG_CMSIS_DSP_FASTMATH=y
CONFIG_CMSIS_DSP_FILTERING=y
CONFIG_CMSIS_DSP_MATRIX=y
CONFIG_CMSIS_DSP_STATISTICS=y
CONFIG_CMSIS_DSP_TRANSFORM=n
CONFIG_CMSIS_DSP_SUPPORT=y

# timer config
CONFIG_NRFX_TIMER0=y
CONFIG_NRFX_TIMER1=y

#FPU config
CONFIG_FPU=y
CONFIG_FP_HARDABI=y


# Library for buttons and LEDs
CONFIG_DK_LIBRARY=y



# Enable bluetooth and bonding
CONFIG_BT=y

#CONFIG_BT_BONDABLE=y
#CONFIG_BT_BONDING_REQUIRED=y


CONFIG_BT_DEVICE_APPEARANCE=833

CONFIG_BT_MAX_CONN=1



CONFIG_BT_PERIPHERAL=y
#CONFIG_BT_GAP_PERIPHERAL_PREF_PARAMS=y
CONFIG_BT_PERIPHERAL_PREF_MAX_INT=40
CONFIG_BT_PERIPHERAL_PREF_MIN_INT=24
CONFIG_BT_PERIPHERAL_PREF_LATENCY=0

#this is in miliseconds

CONFIG_BT_PERIPHERAL_PREF_TIMEOUT=800
CONFIG_BT_DEVICE_NAME="MSense4Right"


#CONFIG_BT_DEVICE_NAME_DYNAMIC=y



#CONFIG_BT_CTLR=y
#CONFIG_BT_CTLR_TX_PWR_ANTENNA=-8
#CONFIG_BT_CTLR_TX_PWR_MINUS_40=y


CONFIG_BT_SMP=n

# ENABLE device information service for bluetooth
CONFIG_BT_DIS=y
CONFIG_BT_DIS_MANUF="SenseLab"
CONFIG_BT_DIS_PNP=n
CONFIG_BT_DIS_MODEL="4.5.3 NAND"
CONFIG_BT_DIS_SETTINGS=y
CONFIG_BT_MAX_PAIRED=1

# Enable Battery service settings
CONFIG_BT_BAS=y

# I belive we do this because the flash reset function has a lot of stack usage.
CONFIG_BT_RX_STACK_SIZE=4096
#DFU/FOTA settings

#temporarily disabling for now

#CONFIG_MCUMGR=y
#
#CONFIG_STATS=y
#CONFIG_STATS_NAMES=y

#CONFIG_THREAD_MONITOR=y


CONFIG_BOOTLOADER_MCUBOOT=y

CONFIG_NCS_SAMPLE_MCUMGR_BT_OTA_DFU=y
#CONFIG_MCUBOOT_GENERATE_CONFIRMED_IMAGE=y


#CONFIG_MCUMGR_LOG_LEVEL_DBG=n

#CONFIG_MCUMGR_SMP_BT_AUTHEN=n

# For saving settings of bluetooth and other variables, turned off as there are currently issues getting it to work
#CONFIG_BT_SETTINGS=y
#CONFIG_SETTINGS_RUNTIME=y
#CONFIG_SETTINGS_NVS=y
#CONFIG_NVS=y

#CONFIG_SETTINGS_NONE=y

# not sure what this is
#CONFIG_MPU_ALLOW_FLASH_WRITE=y



CONFIG_TEST_RANDOM_GENERATOR=y
CONFIG_TIMER_RANDOM_GENERATOR=y


# Flash Driver Config
CONFIG_SPI_NOR=n
CONFIG_FLASH=y
CONFIG_NORDIC_QSPI_NOR=n
CONFIG_FLASH_MAP=y
CONFIG_FLASH_PAGE_LAYOUT=y
CONFIG_FLASH_LOG_LEVEL_WRN=y

CONFIG_SPI_NOR_FLASH_LAYOUT_PAGE_SIZE=4096

# Partition Manager Config

CONFIG_PM_EXTERNAL_FLASH_MCUBOOT_SECONDARY=n

# Disk Driver Config
CONFIG_DISK_DRIVER_FLASH=n
CONFIG_DISK_DRIVER_RAM=n
CONFIG_DISK_DRIVER_RAW_NAND=y

# File System Config
CONFIG_FILE_SYSTEM=y
CONFIG_PM_OVERRIDE_EXTERNAL_DRIVER_CHECK=y
CONFIG_MASS_STORAGE_DISK_NAME="SD"
#CONFIG_FILE_SYSTEM_LITTLEFS=y
CONFIG_FAT_FILESYSTEM_ELM=y

CONFIG_FS_FATFS_READ_ONLY=n
# below config is necessary because this determines the buffer fatfs internally uses to store reads which we do at a size of 4096
CONFIG_FS_FATFS_MAX_SS=4096
CONFIG_FS_FATFS_EXFAT=n
CONFIG_FS_FATFS_MAX_ROOT_ENTRIES=4096
CONFIG_FS_FATFS_LFN=y


CONFIG_FS_LITTLEFS_CACHE_SIZE=128
CONFIG_FS_LITTLEFS_READ_SIZE=16
CONFIG_FS_LITTLEFS_PROG_SIZE=16




#USB related configs
CONFIG_USB_DEVICE_STACK=y
CONFIG_USB_DEVICE_PRODUCT="Zephyr MSC sample"
CONFIG_USB_DEVICE_PID=0x0008
CONFIG_USB_MASS_STORAGE=y

CONFIG_USB_DEVICE_LOG_LEVEL_INF=y
CONFIG_USB_MASS_STORAGE_LOG_LEVEL_INF=y
CONFIG_USB_DEVICE_INITIALIZE_AT_BOOT=n
CONFIG_MASS_STORAGE_STACK_SIZE=4096


# Our custom Configs, which are defined in the "Kconfig" file
CONFIG_USB_ALWAYS_ON=y
CONFIG_MSENSE3_BLUETOOTH_DATA_UPDATES=n

CONFIG_USE_FIXED_PPG_BRIGHTNESS=n

CONFIG_LOG_LEVEL_IMU_COLLECTION=2
CONFIG_LOG_LEVEL_PPG_COLLECTION=2


# General System Memory and stack Configs
CONFIG_SYSTEM_WORKQUEUE_STACK_SIZE=20192
#CONFIG_SYSTEM_WORKQUEUE_PRIORITY=0
#CONFIG_SYSTEM_WORKQUEUE_NO_YIELD=y

CONFIG_HEAP_MEM_POOL_SIZE=5384
CONFIG_MAIN_STACK_SIZE=20192
```

## src/main.c
```c
/*
 * Copyright (c) 2016 Intel Corporation
 *
 * SPDX-License-Identifier: Apache-2.0
 */

#include <zephyr/kernel.h>
#include <zephyr/devicetree.h>
#include <zephyr/drivers/gpio.h>
#include <zephyr/drivers/spi.h>
#include <zephyr/drivers/i2c.h>
#include <zephyr/drivers/sensor.h>
#include <nrfx.h>
#include <nrfx_timer.h>
#include <nrfx_uarte.h>
#include <zephyr/logging/log.h>
#include <zephyr/usb/usb_device.h>
#include "batteryMonitor.h"
#include "ppgSensor.h"
#include "imuSensor.h"
#include "common.h"
#include "BLEService.h"
#include "zephyrfilesystem.h"
#include <zephyr/shell/shell.h>
#include <zephyr/bluetooth/bluetooth.h>
#include <zephyr/bluetooth/hci.h>
#include <zephyr/bluetooth/conn.h>
#include <zephyr/bluetooth/uuid.h>
#include <zephyr/bluetooth/gatt.h>

// dfu configuration


#ifdef INCLUDE_DFU
#ifdef CONFIG_BOOTLOADER_MCUBOOT 

#include "os_mgmt/os_mgmt.h"
#include "img_mgmt/img_mgmt.h"
#include "stats/stats.h"
#include "stat_mgmt/stat_mgmt.h"

#include <mgmt/mcumgr/smp_bt.h>
#endif
#endif

LOG_MODULE_REGISTER(main);

#define READMASTER 0x80

/* 1000 msec = 1 sec */
#define SLEEP_TIME_MS 5000

/* The devicetree node identifier for the "led0" alias. */
#define LED0_NODE DT_ALIAS(led0)
#define LED1_NODE DT_ALIAS(led1)
#define PPG_POWER_NODE DT_ALIAS(led2) 

// #define LED0	DT_GPIO_LABEL(LED0_NODE, gpios)
// #define LED0 DEVICE_DT_NAME(LED0_NODE)
#define LED_PIN DT_GPIO_PIN(LED0_NODE, gpios)
#define LED_FLAGS DT_GPIO_FLAGS(LED0_NODE, gpios)

#define LED1_PIN DT_GPIO_PIN(LED1_NODE, gpios)

#define PPG_POWER_PIN DT_GPIO_PIN(PPG_POWER_NODE, gpios)
#define PPG_POWER_FLAGS DT_GPIO_FLAGS(PPG_POWER_NODE, gpios)

const struct device* gpio0_device;
const struct device* gpio1_device;

struct spi_cs_control imu_cs = {
    .delay = 0,
    .gpio = {.pin = 26, .dt_flags = GPIO_ACTIVE_LOW}};

// the gpio struct now requires a port? not sure what to do in this case
struct spi_cs_control ppg_cs = {
    .delay = 0,
    .gpio = {
        .pin = 9,
        .dt_flags = GPIO_ACTIVE_LOW,
    }};
/*
------------------------------------------------------------------------------------
SPI Mode    CPOL 	CPHA 	Clock Polarity  Clock Phase Used to
                                in Idle State 	Sample and/or Shift the Data
------------------------------------------------------------------------------------
0               0         0 	Logic low 	Data sampled on rising edge and
                                                shifted out on the falling edge
1               0         1 	Logic low 	Data sampled on the falling edge and
                                                shifted out on the rising edge
2               1         1 	Logic high 	Data sampled on the falling edge and
                                                shifted out on the rising edge
3               1         0 	Logic high 	Data sampled on the rising edge and
                                                shifted out on the falling edge
-------------------------------------------------------------------------------------
*/
// SPI Mode-3 IMU
struct spi_config spi_cfg_imu =
{
    .frequency = 1000000,
    .operation = SPI_WORD_SET(8) | SPI_TRANSFER_MSB |
                 SPI_MODE_CPOL | SPI_MODE_CPHA,
    .slave = 0,
    // this should work, but for some reason it doesn't. However, this might work without
    // the cs field anyway, apparently it is auto managed, so test first
    //.cs = SPI_CS_CONTROL_PTR_DT(DT_NODELABEL(spi2), 0)
    };

//struct spi_config spi_cfg_imu2 = SPI_CONFIG_DT(DT_NODELABEL(spi2), spi_cfg_imu.operation, 0);

// SPI Mode-3 PPG
struct spi_config spi_cfg_ppg = {
    .frequency = 4000000,
    .operation = SPI_WORD_SET(8) | SPI_TRANSFER_MSB |
                 SPI_MODE_CPOL | SPI_MODE_CPHA,
    .slave = 0,
    /* only in version 2.5: .cs= {
  .delay = 0,
  .gpio = {.pin = 15, .dt_flags=GPIO_ACTIVE_LOW, }
  },
  */
};


struct ppgData ppgData1;

const struct device *spi_dev_ppg, *spi_dev_imu;
const struct device *i2c_dev;



uint8_t blePktTFMicro[ble_tfMicroPktLength];

struct accData currentAccData;
struct gyroData current_gyro_data;
struct magnetoData current_magneto_data;

struct accel_config accelConfig;
struct gyro_config gyroConfig;
struct magneto_config magnetoConfig;
struct orientation_config orientationConfig;

#define DEVICE_NAME CONFIG_BT_DEVICE_NAME
#define DEVICE_NAME_LEN (sizeof(DEVICE_NAME) - 1)

#define DIS_FW_REV_STR CONFIG_BT_DIS_FW_REV_STR
#define DIS_FW_REV_STR_LEN (sizeof(DIS_FW_REV_STR))

#define DIS_HW_REV_STR CONFIG_BT_DIS_HW_REV_STR
#define DIS_HW_REV_STR_LEN (sizeof(DIS_HW_REV_STR))

#define DIS_MANUF CONFIG_BT_DIS_MANUF
#define DIS_MANUF_LEN (sizeof(DIS_MANUF))

#define DIS_MODEL CONFIG_BT_DIS_MODEL
#define DIS_MODEL_LEN (sizeof(DIS_MODEL))

#define RUN_STATUS_LED DK_LED1

static K_SEM_DEFINE(ble_init_ok, 0, 1);

uint16_t global_counter;

static const struct bt_data ad[] = {
    BT_DATA_BYTES(BT_DATA_FLAGS, (BT_LE_AD_GENERAL | BT_LE_AD_NO_BREDR)),
    BT_DATA(BT_DATA_NAME_COMPLETE, DEVICE_NAME, DEVICE_NAME_LEN),
};

static const struct bt_data sd[] = {
    BT_DATA_BYTES(BT_DATA_UUID128_ALL, CONTROL_SERVICE_UUID),
};

// Shell Commands for entering in the terminal, in case a bluetooth command is not avalible.
SHELL_CMD_REGISTER(reset, NULL, "Resets Device", NVIC_SystemReset);
SHELL_CMD_REGISTER(full_reset, NULL, "Resets Storage and Device", reset_device);

struct bt_conn *my_connection;

// Setting up the device information service
static int settings_runtime_load(void)
{

/*#ifdef CONFIG_BOOTLOADER_MCUBOOT
  settings_runtime_set("bt/dis/model",
                       DIS_MODEL, DIS_MODEL_LEN);
  settings_runtime_set("bt/dis/manuf",
                       DIS_MANUF, DIS_MANUF_LEN);
  settings_runtime_set("bt/dis/fw",
                       DIS_FW_REV_STR, DIS_FW_REV_STR_LEN);
  settings_runtime_set("bt/dis/hw",
                       DIS_HW_REV_STR, DIS_HW_REV_STR_LEN);
#endif
*/
  return 0;
}

void write_uuid_file(){
  bt_addr_le_t address = {0};
  size_t count = 1;
  char addr_str[800]; 
  //bt_le_oob_get_local()
  bt_id_get(&address, &count);
  bt_addr_le_to_str(&address, addr_str, sizeof(addr_str));
  printk("advertising with address: %s \n", addr_str);
  strcat(addr_str, "\n Name:");
  strcat(addr_str, CONFIG_BT_DEVICE_NAME);
  strcat(addr_str, "\n Version: ");
  strcat(addr_str, CONFIG_BT_DIS_MODEL);
  
  
  int result = write_ble_uuid(addr_str);
  if (result > 0){
    
  }
}

static bool le_param_req(struct bt_conn *conn, struct bt_le_conn_param *param)
{
  // If acceptable params, return true, otherwise return false.
  if ((param->interval_min > 9) && (param->interval_max > 20))
    return false;
  else
    return true;
}

static void le_param_updated(struct bt_conn *conn, uint16_t interval, uint16_t latency, uint16_t timeout)
{
  struct bt_conn_info info;
  char addr[BT_ADDR_LE_STR_LEN];

  if (bt_conn_get_info(conn, &info))
    printk("Could not parse connection info\n");
  else
  {
    bt_addr_le_to_str(bt_conn_get_dst(conn), addr, sizeof(addr));
    printk("Connection parameters updated!	\n\
      Connected to: %s						\n\
      New Connection Interval: %u				\n\
      New Slave Latency: %u					\n\
      New Connection Supervisory Timeout: %u	\n",
           addr, info.le.interval, info.le.latency, info.le.timeout);
  }
}

static struct bt_conn_cb conn_callbacks = {
    .connected = connected,
    .disconnected = disconnected,
    //.le_param_req = le_param_req,
    .le_param_updated = le_param_updated};

static void bt_ready(int err)
{
  if (err)
  {
    printk("BLE init failed with error code %d\n", err);
    return;
  }
  else
    printk("BLE init success\n");

  #if CONFIG_BT_SETTINGS
    settings_load();
  #endif

  //settings_runtime_load();

  // Configure connection callbacks
  bt_conn_cb_register(&conn_callbacks);


  if (err)
    return;

  // Start advertising
  const struct bt_le_adv_param v = {
      .id = BT_ID_DEFAULT,
      .sid = 0,
      .secondary_max_skip = 0,
      .options = BT_LE_ADV_OPT_CONNECTABLE | BT_LE_ADV_OPT_USE_IDENTITY,
      .interval_min = BT_GAP_ADV_FAST_INT_MIN_2,
      .interval_max = BT_GAP_ADV_FAST_INT_MAX_2,
      .peer = NULL};

  // if this doesn't work we can use
  /* 
  static struct bt_le_adv_param *adv_param = BT_LE_ADV_PARAM((BT_LE_ADV_OPT_CONNECTABLE|BT_LE_ADV_OPT_USE_IDENTITY), 
                800, //Min Advertising Interval 500ms (800*0.625ms) 
                801, //Max Advertising Interval 500.625ms (801*0.625ms)
                NULL); // Set to NULL for undirected advertising
  */
  err = bt_le_adv_start(&v, ad, ARRAY_SIZE(ad), sd, ARRAY_SIZE(sd));
  if (err)
    printk("Advertising failed to start (err %d)\n", err);
  else
  {
    printk("Advertising successfully started\n");
  }

  k_sem_give(&ble_init_ok);

  write_uuid_file();
  #ifndef CONFIG_DEBUG
  #if CONFIG_DISK_DRIVER_RAW_NAND
    set_read_only(true);
  #endif
    usb_enable(usb_status_cb);
  #endif
}

// Initialize BLE
static void ble_init(void)
{
  int err;
  //bt_uuid_create()
  
  err = bt_enable(bt_ready);
  if (err)
  {
    printk("BLE initialization failed\n");
  }

  //err = bt_id_create(BT_ADDR_LE_ANY, NULL);
  if (!err)
    printk("Bluetooth initialized\n");
  else
  {
    printk("BLE initialization did not complete in time\n");
  }
  if (err)
    printk("Bluetooth init failed (err %d)\n", err);
}

// Timer handler that periodically executes commands with a period,
// which is defined by the macro-variable TIMER_MS
static void spi_init(void)
{
  uint32_t dataFlash;
  // device_get_binding is used for runtime aquisition of a device object. We can still use it but we have to be carefull to select the right names
  const char *const spiName_imu = "spi@9000";
  const char *const spiName_ppg = "spi@c000";

  spi_dev_imu = DEVICE_DT_GET(DT_NODELABEL(spi2)); // device_get_binding(spiName_imu);
  spi_dev_ppg = DEVICE_DT_GET(DT_NODELABEL(spi3));
  //spi_dev_ppg = device_get_binding(spiName_ppg);

  if (!device_is_ready(gpio0_device))
  {
    printk("Could not get GPIO_0\n");
    return;
  }

  if (!device_is_ready(gpio1_device))
  {
    printk("Could not get GPIO_1\n");
    return;
  }
  if (spi_dev_imu == NULL || !device_is_ready(spi_dev_imu))
  {
    printk("Could not get %s device\n", spiName_imu);
    return;
  }

  if (spi_dev_ppg == NULL || !device_is_ready(spi_dev_ppg))
  {
    printk("Could not get %s device\n", spiName_ppg);
    return;
  }
  
  imu_cs.gpio.port = gpio0_device;
  ppg_cs.gpio.port = gpio1_device;
  
  struct spi_config* spi_test_config = spi_dev_imu->config;
  //spi_cfg_ppg.gpio.port = gpio1_device;
  spi_cfg_imu.cs = imu_cs;
  spi_cfg_ppg.cs = ppg_cs; // version 2.5: .gpio.port = gpio1_device;

  getIMUID();
  
  // high_pass_filter_init_25();

  // fileOpen();
  dataFlash = (((uint32_t)ppgConfig.green_intensity) << 8) + ((uint32_t)ppgConfig.infraRed_intensity);
  printk("data combo = %d,%d,%d\n", dataFlash, ((uint32_t)ppgConfig.green_intensity) << 8, (uint32_t)ppgConfig.infraRed_intensity);
  // fileWrite(dataFlash);
  // fileClose();

  accelConfig.isEnabled = true;
  accelConfig.txPacketEnable = true;
  accelConfig.sample_bw = ACCEL_DLPFCFG_12HZ;
  accelConfig.sensitivity = ACCEL_FS_SEL_4g;

  gyroConfig.isEnabled = true;
  gyroConfig.txPacketEnable = true;
  gyroConfig.tot_samples = 10;
  gyroConfig.sensitivity = GYRO_FS_SEL_500;
  orientationConfig.isEnabled = true;
  orientationConfig.txPacketEnable = true;

  magnetoConfig.isEnabled = false;
  magnetoConfig.txPacketEnable = true;
  //tfMicroCoonfig.isEnabled = true;
  //tfMicroCoonfig.txPacketEnable = true;

  configRead[1] = IMU_ENABLE | MAGNETOMETER_ENABLE | PPG_ENABLE |
                  ORIENTATION_ENABLE | TFMICRO_ENABLE;
  configRead[0] = MOTION_BLE_ENABLE | MAGNETOMETER_BLE_ENABLE |
                  PPG_BLE_ENABLE | ORIENTATION_BLE_ENABLE | TFMICRO_BLE_ENABLE;
  configRead[2] = ppgConfig.green_intensity;
  configRead[3] = ppgConfig.infraRed_intensity;
  configRead[4] = 0x12;
  configRead[5] = 0x44;
}

void spi_verify_sensor_ids()
{
  uint8_t tx_buffer[4], rx_buffer[4];
  tx_buffer[0] = READMASTER | 0x00;
  tx_buffer[1] = 0xFF;
  uint8_t txLen = 2, rxLen = 2;
  if (device_is_ready(spi_dev_imu))
  {
    getIMUID();
  }
  else
  {
    LOG_WRN("IMU not ready, setup was avoided");
  }

  tx_buffer[0] = PPG_CHIP_ID_1;
  tx_buffer[1] = READMASTER;
  tx_buffer[2] = 0x00;

  txLen = 3;
  rxLen = 3;
  k_sleep(K_SECONDS(1));
  if (device_is_ready(spi_dev_ppg))
  {
    spiReadWritePPG(tx_buffer, txLen, rx_buffer, rxLen);
    LOG_INF("Chip ID from ppg sensor=%x,%x,%x\n", rx_buffer[0], rx_buffer[1], rx_buffer[2]);
  }
  else
  {
    LOG_WRN("ppg not ready, setup was avoided");
  }
}

static void i2c_init(void)
{

  printk("The I2C Init started\n");
  i2c_dev = DEVICE_DT_GET(DT_NODELABEL(i2c1));
  if (!device_is_ready(i2c_dev))
  {
    printk("Binding failed to i2c.");
    return;
  }
  // Previously we used to set values, but these are now set by device tree.
}

// Timer handler that periodically executes commands with a period,
// which is defined by the macro-variable TIMER_MS

#define WORKQUEUE_PRIORITY 8
#define WORKQUEUE_STACK_SIZE 20048
K_THREAD_STACK_DEFINE(my_stack_area, WORKQUEUE_STACK_SIZE);





void battery_maintenance()
{
  const struct device *const dev = DEVICE_DT_GET_ONE(ti_bq274xx);
  dt_update_battery(dev);
  
  //battery_lvl = bt_bas_get_battery_level();
  #ifndef CONFIG_MSENSE3_BLUETOOTH_DATA_UPDATES
  if (collecting_data || host_wants_collection){
        if (battery_level < 10 && collecting_data){
            battery_low = true;
            start_stop_device_collection(false);
        }
        else if (battery_level > 15 && host_wants_collection && !collecting_data){
            battery_low = false;
            start_stop_device_collection(true);
            
        }
  }
  #endif
    
}



void blink_led(gpio_pin_t pin){
  gpio_pin_set(gpio0_device, pin, 1);
  k_sleep(K_MSEC(200));
  gpio_pin_set(gpio0_device, pin, 0);
}



void storage_clear_led(){
  gpio_pin_set(gpio0_device, LED1_PIN, 1);
}

void main(void)
{

  printk("Starting Application... \n");
  LOG_INF("Starting Logging...\n");
  
  // Setup LEDs and Power Pins
  

  // Setup our Flash Filesystem
  setup_disk();
  k_sleep(K_SECONDS(1));
  //create_test_files(10);
  #ifdef CONFIG_DEBUG  
  #if CONFIG_DISK_DRIVER_RAW_NAND
    set_read_only(true);
  #endif
    usb_enable(usb_status_cb);
  #endif
  k_sleep(K_SECONDS(2));

  
// this initializes FOTA
#ifdef INCLUDE_DFU
#ifdef CONFIG_BOOTLOADER_MCUBOOT
  os_mgmt_register_group();

  img_mgmt_register_group();
  smp_bt_register();
#endif
#endif

  // the "1" is the timer priority
  IRQ_CONNECT(TIMER1_IRQn, 1,
              nrfx_timer_1_irq_handler, NULL, 0);


  
  
  
  
  gpio0_device = DEVICE_DT_GET(DT_NODELABEL(gpio0));
  gpio1_device = DEVICE_DT_GET(DT_NODELABEL(gpio1));
  
  int ret;
  // Initialize our 2 LED pins and 5V PPG Power Pin
  ret = gpio_pin_configure(gpio0_device, LED_PIN, GPIO_OUTPUT_INACTIVE | LED_FLAGS);
  ret = gpio_pin_configure(gpio0_device, LED1_PIN, GPIO_OUTPUT_INACTIVE | LED_FLAGS);
  ret = gpio_pin_configure(gpio1_device, PPG_POWER_PIN, GPIO_OUTPUT_ACTIVE | PPG_POWER_FLAGS);
  // initialize imu ground pin
  //ret = gpio_pin_configure(gpio0_device, 27, GPIO_OUTPUT_INACTIVE);
  if (ret < 0)
  {
    printk("Error: Can't initialize LED");
    // return;
  }
  
  // Init, verify ID and config sensors
  
  spi_init();
  spi_verify_sensor_ids();

  

  i2c_init();

  // Shutdown our ppg and imu sensors until we need to get data from them
  ppg_sleep();
  motion_sleep();


  // Start Threads for all our sensor tasks
  // This is the file system workqueue (workqueues are threads that process items in a queue), it processes uploading files to the filesystem. 
  k_work_queue_init(&my_work_q);
  k_work_queue_start(&my_work_q, my_stack_area,
                     K_THREAD_STACK_SIZEOF(my_stack_area), WORKQUEUE_PRIORITY, NULL);
  // Handles reading from the motion sensor and ppg sensor. This is the system workqueue, which zephyr creates by default
  // and is a different queue from the user created file system workqueue 
  k_work_init(&my_motionSensor.work, motion_data_timeout_handler);
  k_work_init(&my_ppgSensor.work, read_ppg_fifo_buffer);
  // sends enmo and accelerometer
  k_work_init(&my_motionData.work, motion_notify);
#ifdef CONFIG_MSENSE3_BLUETOOTH_DATA_UPDATES
  // These items all handle sending data across bluetooth
  
  k_work_init(&my_magnetoSensor.work, magneto_notify);
  k_work_init(&my_orientaionSensor.work, orientation_notify);
  k_work_init(&my_ppgDataSensor.work, ppgData_notify);
#endif

  
  k_work_init(&ppg_work_item.work, work_write);
  ppg_work_item.sensor = ppg;

  k_work_init(&accel_work_item.work, work_write);
  accel_work_item.sensor = accelorometer;
  ble_init();
  
  get_storage_percent_full();
  
  
  // we set global update at 9 so that when we are entering the while loop, we will check the storage & battery.
  int global_update = 9;
  int update_time = SLEEP_TIME_MS;
  

  while (1)
  {
    
    printk("%d %d\n", connectedFlag, collecting_data);

    global_update++;
    if (global_update >= 100){
      global_update = 0;
    }

    if (global_update % 10 == 0){
      battery_maintenance();
      get_current_unix_time();
      LOG_INF("state: %d", k_work_busy_get(&accel_work_item.work));
      if (!file_lock){
      }
    }

    if (!connectedFlag){
    // blink the LED while we aren't connected.
      blink_led(LED_PIN);
    }
    else {
      // When Connected, LED instead only blinks once every 10 cycles
      if (global_update % 10 == 0){
        blink_led(LED_PIN);
      }
    }
      
    
    if (collecting_data){
        blink_led(LED1_PIN);
    }

    k_msleep(update_time);
  }
}
```

## src/zephyrfilesystem.c
```c
#include <zephyr/kernel.h>
#include <zephyr/fs/fs.h>
#include <nrfx_qspi.h>
#include <zephyr/logging/log.h>
#include <zephyr/random/rand32.h>
#include <time.h>


#include <stdlib.h>
#include "zephyrfilesystem.h"


LOG_MODULE_REGISTER(zephyrfilesystem, 3);

#if CONFIG_DISK_DRIVER_FLASH
#include <zephyr/storage/flash_map.h>
#endif

#if CONFIG_DISK_DRIVER_RAW_NAND
#include "drivers/nand/spi_nand.h"
#endif

#if CONFIG_FAT_FILESYSTEM_ELM
#include <ff.h>
#define STORAGE_PARTITION_ID FIXED_PARTITION_ID(PM_LITTLEFS_STORAGE_NAME)
#endif

#if CONFIG_FILE_SYSTEM_LITTLEFS
#include <zephyr/fs/littlefs.h>
FS_LITTLEFS_DECLARE_DEFAULT_CONFIG(storage);

#define STORAGE_PARTITION		storage_partition
#define STORAGE_PARTITION_ID		FIXED_PARTITION_ID(STORAGE_PARTITION)
#endif



#define MAX_BUFFER_SIZE 9000

#define GET_FATTIME() (DWORD)get_current_unix_time()
#undef GET_FATTIME()



// Might need to put this and the timer in a seperate file.

struct k_work_q my_work_q;

memory_container ppg_work_item;

memory_container accel_work_item;

//data limit per file in bytes
static int data_limit = MAX_BUFFER_SIZE;




// external globals
int storage_percent_full;

int upload_timeout_errors;

bool file_lock;

uint64_t last_time_update_sent;

uint64_t set_date_time = 0;

int patient_num = 0;

int packet_number = 0;

int last_packet_number_processed = 0;

static int current_file_count;

const int max_writes = 256;

typedef struct k_sensor_upload {
	enum sensor_type sensor;
	struct k_work work;
};


typedef struct data_upload_buffer {
	char data_upload_buffer[MAX_BUFFER_SIZE];
	size_t current_size;
} data_upload_buffer;


// settings
bool use_random_files = false;
bool direct_write_file = true; 




// internally linked globals
static struct fs_mount_t fs_mnt;
//counter to serve as a amount for when the file fills up.
static int data_counter;
char file_name[50] = "";
static bool first_write = false;
static struct fs_file_t file;



typedef struct MotionSenseFile {
	int write_size;
	int current_writes;
	int data_counter;
	char sensor_string[5];
	char file_name[50];
	char sensor_format[80];
	struct fs_file_t self_file;
	bool switch_buffer;
	data_upload_buffer buffer1;
	data_upload_buffer buffer2;
	
} 	MotionSenseFile;



//File Objects
static MotionSenseFile current_file;

MotionSenseFile ppg_file = {
	.write_size = 8192,
	.sensor_string = "ppg",
	.sensor_format = "4 channels of uint32 ppg, uint32 timer and uint32 counter"
};

MotionSenseFile accel_file = {
	.write_size = 8192,
	.sensor_string = "ac",
	.sensor_format = "3 int16 accel, 3 float32 gyro, uint32 timer, uint32 counter"
};


void enable_read_only(bool enable){
	struct fs_mount_t* mp = &fs_mnt;
	if (mp->type == FS_FATFS){
		#if CONFIG_FAT_FILESYSTEM_ELM
		if (enable){
			//f_chmod(mp->mnt_point, AM_RDO, AM_RDO);
		}
		else{
			//f_chmod(mp->mnt_point, 0, AM_RDO);
		}
		#endif
	}
}


void create_test_file(int sectors){
	printk("trying to write file...\n");
	
	char destination[50] = "";
	int ID = 0;
	struct fs_mount_t* mp = &fs_mnt;
	char IDString[12];


	struct fs_file_t test_file;
	fs_file_t_init(&test_file);
	
	ID = sys_rand32_get() % 90000;
	itoa(ID, IDString,  10);

	strcat(destination, mp->mnt_point);
	strcat(destination, "/");
	strcat(destination, IDString);
	strcat(destination, "testing.txt");
	int file_create = fs_open(&test_file, destination, FS_O_CREATE | FS_O_WRITE);
	if (file_create == 0)
	{
		char a[4096 * 2] = "hello world, this is a story about a man who liked to run. \
		every day for miles. he wandered and wandered for miles.";
		for (int i = 0; i < sectors; i++)
		{
			printk("trying to write...\n");
			fs_write(&test_file, a, sizeof(a));
		}
		printk("done writing\n");
		fs_close(&test_file);
	}
}

void create_test_files(int number_of_files){

	for (int x = 0; x < number_of_files; x++){
		create_test_file(256);
	}


}

void create_sensor_file(MotionSenseFile* MSenseFile){

}

void reset_sensor_file(MotionSenseFile* MSenseFile){
	fs_close(&MSenseFile->self_file);
	MSenseFile->buffer1.current_size = 0;
	MSenseFile->buffer2.current_size = 0;
	MSenseFile->switch_buffer = false;
	MSenseFile->current_writes = 0;
}

void sensor_write_to_file(const void* data, size_t size, enum sensor_type sensor){
	struct fs_mount_t* mp = &fs_mnt;
	MotionSenseFile* MSenseFile;
	if (storage_percent_full >= 99){
		LOG_WRN("Storage is getting full, aborting write");
		return;
	}
	if (sensor == ppg){
		MSenseFile = &ppg_file;
	}
	else if (sensor == accelorometer){
		MSenseFile = &accel_file;
	}


	if (MSenseFile->current_writes == 0){
		// Create a new file, with given sensor type, patient name, and date
		fs_file_t_init(&MSenseFile->self_file);
		
		
		int ID = 0;
		// max itoa can do is 33 with binary, but theoretically it will be < 9
		char IDString[33];
		char patient_id[33];
		if (use_random_files){
			
		
			ID = sys_rand32_get() % 900;
			
		}
		else {
			uint64_t current_time = get_current_unix_time();
			ID = current_time;

		}
		itoa(ID, IDString,  10);
		

		memset(MSenseFile->file_name, 0, sizeof(MSenseFile->file_name));
		strcat(MSenseFile->file_name, mp->mnt_point);
		strcat(MSenseFile->file_name, "/");
		if (patient_num != 0){
			itoa(patient_num, patient_id, 10);
			strcat(MSenseFile->file_name, patient_id);	
		}
		strcat(MSenseFile->file_name, MSenseFile->sensor_string);
		strcat(MSenseFile->file_name, IDString);
		strcat(MSenseFile->file_name, ".bin");
		//printk("file: %s \n", file_name); 
		LOG_INF("Creating new file...");
		int file_create = fs_open(&MSenseFile->self_file, MSenseFile->file_name, FS_O_CREATE | FS_O_WRITE);
		if (file_create != 0){
			LOG_WRN("Unable to create file");
		}
		// we write in sizes of 4096*2, so we include that in the formula
		FRESULT res = f_expand(MSenseFile->self_file.filep, 4096*max_writes*2, 1);
		if (res != 0){
		LOG_WRN("failed to expand file");
		}

		// write unix time as first sample
		uint64_t current_time = get_current_unix_time();
		int total_written = fs_write(&MSenseFile->self_file, current_time, size);
		MSenseFile->current_writes++;
		if (total_written == size){
			LOG_INF("sucessfully wrote to file for %d, bytes written = %i ! \n", sensor, total_written);
			data_counter += total_written;
		}
		
	}
	else if (data_counter >= data_limit){
		//memset(file_name, 0, sizeof(file_name));
		data_counter = 0;
	}
	
	int total_written = fs_write(&MSenseFile->self_file, data, size);
	MSenseFile->current_writes++;
	//fs_write(&file, data, size);
	if (total_written == size){
		LOG_INF("sucessfully wrote to file for %d, bytes written = %i ! \n", sensor, total_written);
		data_counter += total_written;
	}
	if (MSenseFile->current_writes >= max_writes){
		fs_close(&MSenseFile->self_file);
		LOG_INF("closing file\n");
		MSenseFile->current_writes = 0;
		get_storage_percent_full();
	}
}

// writes data to a single file named 'test.txt' future TODO: make an extra string parameter so that the file name is customizable
void write_to_file(const void* data, size_t size){
	struct fs_mount_t* mp = &fs_mnt;
	if (!first_write ){
		
		fs_file_t_init(&file);
		
		
		int ID = 0;
		char IDString[5];
		if (use_random_files){
			
		
			ID = sys_rand32_get() % 900;
			
		}
		else {
			uint64_t current_time = get_current_unix_time();
			ID = current_time;

		}
		itoa(ID, IDString,  10);

		

		strcat(file_name, mp->mnt_point);
		strcat(file_name, "/");
		strcat(file_name, IDString);
		strcat(file_name, "test.txt");
		//printk("file: %s \n", file_name); 
		int file_create = fs_open(&file, file_name, FS_O_CREATE | FS_O_WRITE);
		first_write = true;

	}
	else if (data_counter >= data_limit){
		//memset(file_name, 0, sizeof(file_name));
		data_counter = 0;
	}
	
	int total_written = fs_write(&file, data, size);
	//fs_write(&file, data, size);
	if (total_written = size){
		//printk("sucessfully wrote file, bytes written = %i ! \n", total_written);
		data_counter += total_written;
	}
}




void work_write(struct k_work* item){
	
	memory_container* container =
        CONTAINER_OF(item, memory_container, work);
	
	start_timer();
	LOG_INF("writing true for container %d", container->sensor);
	container->in_use = true;
	sensor_write_to_file(container->address, container->size, container->sensor);
	int64_t time_value = stop_timer();
	LOG_INF("write timer: %lli", time_value);
	// packets should always be in FIFO order for the queue, for sake of the data order. This check makes sure this is always ensured.
	if (container->packet_num <= last_packet_number_processed){
		LOG_ERR("FIFO in k_work not met.");	
	}
	LOG_INF("Processing packet %i", container->packet_num);
	last_packet_number_processed = container->packet_num;
	LOG_INF("writing false for container %d", container->sensor);
	container->in_use = false;

}

void submit_write(const void* data, size_t size, enum sensor_type type){
	
	//memcpy(work_item.address, data, size);
	memory_container* work_item;
	if (type == ppg){
		work_item = &ppg_work_item;
	}
	else if (type == accelorometer){
		work_item = &accel_work_item;
	}
	LOG_INF("state: %d and %d", k_work_busy_get(work_item), k_work_is_pending(work_item));
	
	if (!work_item->in_use){

	work_item->address = data;
	work_item->size = size;
	work_item->sensor = type;
	packet_number++;
	work_item->packet_num = packet_number;
	int ret = k_work_submit_to_queue(&my_work_q, &work_item->work);
	if (ret != 1){
		upload_timeout_errors += 1;
		LOG_ERR("bad ret value for sensor %i: %i, total_errors: %d", type, ret, upload_timeout_errors);
		
	}
	LOG_INF("ret value for %i: %i", type, ret);
	}
	else{
		LOG_ERR("work item attempted schedule while still running for type: %i", type);
	}
}


void store_data(const void* data, size_t size, enum sensor_type sensor){
	LOG_DBG("Store data called");
	data_upload_buffer* current_buffer;
	//int16_t arr[6];
	MotionSenseFile* MSenseFile;
	if (sensor == ppg){
		MSenseFile = &ppg_file;
	}
	else if (sensor == accelorometer){
		MSenseFile = &accel_file;
	}

	if (MSenseFile->switch_buffer){
		current_buffer = &MSenseFile->buffer2;
	}
	else {
		current_buffer = &MSenseFile->buffer1;
	}

	void* address_to_write = &current_buffer->data_upload_buffer[current_buffer->current_size];
	void* result = memcpy(address_to_write, data, size);
	//memcpy(arr, address_to_write, size);
	current_buffer->current_size += size;
	if (current_buffer->current_size + size >= MSenseFile->write_size){
		if (current_buffer->current_size + size != MSenseFile->write_size){
			LOG_WRN("Warning: size of total buffer is overflowing from last, truncating...");
		}
		LOG_INF("Submitting File!");
		submit_write(current_buffer->data_upload_buffer, current_buffer->current_size, sensor);
		current_buffer->current_size = 0;
		MSenseFile->switch_buffer = !MSenseFile->switch_buffer;
	}
}

int write_ble_uuid(const char* uuid){

	struct fs_mount_t* mp = &fs_mnt;
	struct fs_file_t name_file;
	fs_file_t_init(&name_file);
	int res;
	// theoretically zephyr docs say this allows us to test whether the file exists or not?
	char uuid_name[20] = "";
	strcat(uuid_name, mp->mnt_point);
	strcat(uuid_name, "/");
	strcat(uuid_name, "uuid.txt");
	int file_create = fs_open(&name_file, uuid_name, 0);
	// the above function will return error -2 if file name is not present, so we can use it to check whether it gets included or not.
	if (file_create != 0)
	{
		int file_create = fs_open(&name_file, uuid_name, FS_O_CREATE | FS_O_WRITE);
		if (file_create != 0)
		{
			LOG_WRN("Unable to create file");
			return -1;
		}
		// we write in sizes of 4096*2, so we include that in the formula
		// max_writes

		strcat(uuid, "\n ppg format: ");
  		strcat(uuid, ppg_file.sensor_format);

		strcat(uuid, "\n accel format: ");
  		strcat(uuid, accel_file.sensor_format);
		strcat(uuid, "\n for a more complete description of how this device works, please visit https://github.com/SenSE-Lab-OSU/MotionSenseHRV4Flash for more info.");
		//res = f_expand(name_file.filep, 4096 * 4, 1);
		res = fs_write(&name_file, uuid, strlen(uuid));
		res = 1;
	}
	else
	{
		res = 0;
	}
	fs_close(&name_file);
	
	return res;
}

int close_all_files(){

	
	reset_sensor_file(&accel_file);
	reset_sensor_file(&ppg_file);
	
	return 0;

}


static int setup_flash(struct fs_mount_t *mnt)
{
	int rc = 0;
#if CONFIG_DISK_DRIVER_FLASH
	unsigned int id;
	const struct flash_area *pfa;

	mnt->storage_dev = (void *)STORAGE_PARTITION_ID;
	id = STORAGE_PARTITION_ID;

	rc = flash_area_open(id, &pfa);
	LOG_INF("Area %u at 0x%x on %s for %u bytes\n",
	       id, (unsigned int)pfa->fa_off, pfa->fa_dev->name,
	       (unsigned int)pfa->fa_size);

	if (rc < 0 && IS_ENABLED(CONFIG_APP_WIPE_STORAGE)) {
		printk("Erasing flash area ... ");
		rc = flash_area_erase(pfa, 0, pfa->fa_size);
		printk("%d\n", rc);
	}

	if (rc < 0) {
		flash_area_close(pfa);
	}
#endif
	return rc;
}

static int mount_app_fs(struct fs_mount_t *mnt)
{
	int rc;

#if CONFIG_FAT_FILESYSTEM_ELM
	static FATFS fat_fs;
	//FS_MOUNT_FLAG_USE_DISK_ACCESS
	//mnt->flags = FS_MOUNT_FLAG_READ_ONLY;
	mnt->type = FS_FATFS;
	mnt->fs_data = &fat_fs;
	if (IS_ENABLED(CONFIG_DISK_DRIVER_RAM)) {
		mnt->mnt_point = "/RAM:";
	} else if (IS_ENABLED(CONFIG_DISK_DRIVER_SDMMC) | IS_ENABLED(CONFIG_DISK_DRIVER_RAW_NAND) | 
	IS_ENABLED(CONFIG_DISK_DRIVER_FLASH)) {
		mnt->mnt_point = "/SD:";
	}

#elif CONFIG_FILE_SYSTEM_LITTLEFS
	mnt->type = FS_LITTLEFS;
	mnt->mnt_point = "/lfs";
	mnt->fs_data = &storage;
#endif
	rc = fs_mount(mnt);

	return rc;
}

void setup_disk(void)
{
	struct fs_mount_t *mp = &fs_mnt;
	struct fs_dir_t dir;
	struct fs_statvfs sbuf;
	int rc;

	fs_dir_t_init(&dir);

	if (IS_ENABLED(CONFIG_DISK_DRIVER_FLASH)) {
		rc = setup_flash(mp);
		if (rc < 0) {
			LOG_ERR("Failed to setup flash area");
			return;
		}
	}

	if (!IS_ENABLED(CONFIG_FILE_SYSTEM_LITTLEFS) &&
	    !IS_ENABLED(CONFIG_FAT_FILESYSTEM_ELM)) {
		LOG_INF("No file system selected");
		return;
	}

	rc = mount_app_fs(mp);
	if (rc < 0) {
		LOG_ERR("Failed to mount filesystem");
		return;
	}
	/* Allow log messages to flush to avoid interleaved output */
	k_sleep(K_MSEC(50));

	LOG_INF("Mount %s: %d\n", fs_mnt.mnt_point, rc);

	rc = fs_statvfs(mp->mnt_point, &sbuf);
	if (rc < 0) {
		printk("FAIL: statvfs: %d\n", rc);
		return;
	}

	LOG_INF("%s: bsize = %lu ; frsize = %lu ;"
	       " blocks = %lu ; bfree = %lu\n",
	       mp->mnt_point,
	       sbuf.f_bsize, sbuf.f_frsize,
	       sbuf.f_blocks, sbuf.f_bfree);

	rc = fs_opendir(&dir, mp->mnt_point);
	LOG_INF("%s opendir: %d\n", mp->mnt_point, rc);

	if (rc < 0) {
		LOG_ERR("Failed to open directory");
	}

	while (rc >= 0) {
		struct fs_dirent ent = { 0 };

		rc = fs_readdir(&dir, &ent);
		if (rc < 0) {
			LOG_ERR("Failed to read directory entries");
			break;
		}
		if (ent.name[0] == 0) {
			LOG_INF("End of files\n");
			break;
		}
		LOG_INF("  %c %u %s\n",
		       (ent.type == FS_DIR_ENTRY_FILE) ? 'F' : 'D',
		       ent.size,
		       ent.name);
	}

	(void)fs_closedir(&dir);

	return;
}


int get_storage_percent_full(){
	struct fs_statvfs info;
	struct fs_mount_t* mp = &fs_mnt;
	int rc = fs_statvfs(mp->mnt_point, &info);
	if (rc < 0) {
		printk("FAIL: statvfs: %d\n", rc);
		return;
	}

	printk("%s: bsize = %lu ; frsize = %lu ;"
	       " blocks = %lu ; bfree = %lu\n",
	       mp->mnt_point,
	       info.f_bsize, info.f_frsize,
	       info.f_blocks, info.f_bfree);

	float storage_percent = (info.f_blocks - info.f_bfree);
	storage_percent /= info.f_blocks;
	storage_percent *= 100;
	storage_percent_full = (int)storage_percent;
	LOG_INF("storage: %f and %i and total_errors %i", storage_percent, storage_percent_full, upload_timeout_errors);
	return (int)storage_percent;

}

int read_storage_percent_full(){
	return storage_percent_full;
}


void set_date_time_bt(uint64_t value){
	
	set_date_time = value;
	last_time_update_sent = k_uptime_get() / 1000;
	LOG_INF("new datetime sent, value is %llu, seconds uptime is %llu", set_date_time, last_time_update_sent);
	

}

uint64_t get_current_unix_time(){
	
	uint64_t current_upime = k_uptime_get();
	current_upime /= 1000;
	LOG_DBG("current uptime in seconds: %llu", current_upime);
	uint64_t current_time = (current_upime - last_time_update_sent) + set_date_time;
	LOG_DBG("current timestamp: %llu", current_time);
	return current_time;
}

// for now we will use Mountain Time (UTC -7)
#define TIMEZONE_SHIFT -8
// To make this work with the file system, you will need to set FF_FS_NORTC to 0 in  zephyr\modules\fatfs (line 82).
DWORD get_fattime(void)
{
	time_t t;
	struct tm *stm;

	t = get_current_unix_time();
	// stm = localtime(&t);
	if (set_date_time != 0)
	{
		stm = gmtime(&t);
		return (DWORD)(stm->tm_year - 80) << 25 |
			   (DWORD)(stm->tm_mon + 1) << 21 |
			   (DWORD)stm->tm_mday << 16 |
			   (DWORD)(stm->tm_hour + TIMEZONE_SHIFT) << 11 |
			   (DWORD)stm->tm_min << 5 |
			   (DWORD)stm->tm_sec >> 1;
	}
	return 0;
}

int64_t start_time;

void start_timer(){
	start_time = k_uptime_get();
}


int64_t stop_timer(){
	int64_t length = k_uptime_get() - start_time;
	start_time = 0;
	LOG_INF("Timer Value: %lli ms", length);
	return length;
}
```
